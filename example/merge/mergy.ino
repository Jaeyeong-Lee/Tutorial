// play, chord practice 구현 완료 버젼

#include <DueTimer.h>
#include <Wire.h>
#include "stdio.h"
#include <Adafruit_GFX.h>
#include <Adafruit_SSD1306.h>
#include <SPI.h>
#include <SdFat.h>
#include <SdFatUtil.h>
#include <StackArray.h>

StackArray <int> stack;

//#include <Fonts/FreeMono9pt7b.h>
//#include <Fonts/FreeSans9pt7b.h>fdv
//#include <Fonts/FreeSerif9pt7b.h>
//#include <Fonts/FreeSerif12pt7b.h>
#include <Fonts/FreeSerifBold9pt7b.h>
#include <Fonts/FreeSerifBold12pt7b.h>
#include <Fonts/FreeSerifItalic9pt7b.h>


SdFat SD;
ArduinoOutStream cout(SerialUSB);

#define KEY_NONE 0
#define KEY_PREV 1
#define KEY_NEXT 2
#define KEY_SELECT 3

#define MAX_ITEMS 5
#define UP 0


// by SEOL
#define PAUSE_MENU_NUM 4 // the number of pause menus
#define NONE 0
#define SET_A 1
#define SET_B 2

// by umin newcode
#define MAIN_MENU  0
#define PLAYLIST_MENU  1
#define CHORD_MENU  2
#define LIVEPLAY_MENU  3
#define RECORD_MENU  4
#define DOWNLOAD_MENU  5
#define FORMAT_MENU  6
#define SETTING_MENU  7

#define PLAY_MENU  10
#define PAUSE_MENU  11
#define SUBCHORD_MENU  12
#define PLAY_RECORD_MENU 13

#define MAIN_ITEMS 7
#define PLAYLIST_ITEMS 5
#define PAUSE_ITEMS 4
#define CHORD_ITEMS 8
#define SETTING_ITEMS 4
#define SUBCHORD_ITEMS 11

#define MAX_SCAN1 75
#define MAX_SCAN2 65
#define MAX_SCAN3 100
#define MAX_SCAN4 100
#define MAX_SCAN5 300
#define MAX_SCAN6 300

#define MID_SCAN1 20
#define MID_SCAN2 10
#define MID_SCAN3 20
#define MID_SCAN4 20
#define MID_SCAN5 70
#define MID_SCAN6 70

uint8_t mymenu = MAIN_MENU;
uint8_t item_count = 5;

char record_title[9] = "Record01";
char record_artist[5] = "user";
uint8_t record_count = 0;

uint8_t uiKeyCodeFirst = KEY_NONE;
uint8_t uiKeyCodeSecond = KEY_NONE;
uint8_t uiKeyCode = KEY_NONE;

// switch
// for DUE Board
//int encoderPin1 = 2;
//int encoderPin2 = 3;
//int uiKeySelect = 6;

// for All in One Board
int encoderPin1 = 78;
int encoderPin2 = 52;
int uiKeySelect = 21;

int PWR_Latch = 20;
int sw_button = 0;
int key_timer = 0;
int off_time = 2000; // renew

volatile int lastEncoded = 0;
volatile long encoderValue = 0;
volatile long lastencoderValue = 0;

long lastencoderValueUsed = 0; // by SEOL for testing...
//int lastMSB = 0; // 이거 안쓰는것 같은데??
//int lastLSB = 0; // 이거 안쓰는것 같은데??
//unsigned int encoder_updated = 0; // by SEOL for testing.. should be removed if not used

char tempo_string[] = "x1.0";
char *main_strings[MAIN_ITEMS] = {"Play List", "Guitar Chord", "Live Play", "Record", "File Manager", "Format", "Setting"};
char *pause_strings[PAUSE_ITEMS] = { "Resume", "A-B Repeat", "Tempo", "Back" };
char *setting_strings[SETTING_ITEMS] = {"BACK", "Play Tempo", "Record Tempo", "Calibration"};
char *chord_strings[CHORD_ITEMS] = {"\"", "C", "D", "E", "F", "G", "A", "B"};
char *subchord_strings[CHORD_ITEMS][SUBCHORD_ITEMS] = {
  {},
  {"C", "M7", "a9", "7", "m", "m7", "s4", "7s4", "dim", "aug", ""},
  {"D", "M7", "a9", "7", "m", "m7", "s4", "7s4", "dim", "aug", ""},
  {"E", "M7", "a9", "7", "m", "m7", "s4", "7s4", "dim", "aug", ""},
  {"F", "M7", "a9", "7", "m", "m7", "s4", "7s4", "dim", "aug", ""},
  {"G", "M7", "a9", "7", "m", "m7", "s4", "7s4", "dim", "aug", ""},
  {"A", "M7", "a9", "7", "m", "m7", "s4", "7s4", "dim", "aug", ""},
  {"B", "M7", "a9", "7", "m", "m7", "s4", "7s4", "dim", "aug", ""}
};

char *chordnotes_strings[CHORD_ITEMS - 1][5] = { //  "223242" means (2,2) (3,2) (4,2)의 세 개음을 의미 where (line, fret)
  /* C */	{ "214253", "132435455363", "21334253", "1325344553", "1324334553"},
  /* D */ 	{ "122332", "112332", "122132", "122232", "112132"},
  /* E */ 	{ "314252", "4252", "3152", "314152", "52"},
  /* F */ 	{ "112132435361", "112131435361", "112132415361", "213243", "112131415361"},
  /* G */ 	{ "135263", "132333455563", "115263", "125263", "132333435563"},
  /* A */ 	{ "223242", "213242", "2242", "223142", "2142" },
  /* B */ 	{ "122234445462", "1223344452", "12324152", "4253", "132433455363"},
};

typedef struct {
  char title[21];
} Song;

Song songList[20];
char gFilename[] = "FILENAME.TXT";

uint8_t menu_current = 0;
uint8_t pause_menu_current = 0; // by SEOL
uint8_t menu_redraw_required = 0;
uint8_t last_key_code = KEY_NONE;

uint8_t topmenu_index = 0; // default main menu selected value // meaningless
uint8_t menu_count = MAIN_ITEMS; // the number of main menus
uint8_t max_current = menu_count;
uint8_t is_submenu = 0; // check for submenu
uint8_t is_main = 1; // default main menu page
uint8_t is_play = 0; // play page default not play
uint8_t is_code_play = 0; // code practice
uint8_t is_liveplay = 0;
uint8_t is_scroll = 0; // page scroll
uint8_t select_play = 0; // when select playlist file
uint8_t select_main = 0; // default main select
uint8_t play_song = 0; // default play state : playing
uint8_t bluetooth_state = 0; // 0 is bluetooth OFF
uint8_t scroll_index = 0; // default the index of submenu
uint8_t scroll_count = 0; // number of scroll
uint8_t scroll_current = 0; // current scroll
uint8_t chord_current = 0; // current chord
uint8_t is_pause = 0;
uint8_t song_index = 0;
uint8_t is_download = 0;
uint8_t song_count = 0;
uint8_t loading_complete = 0;
uint8_t is_logo_displayed = 0;
uint8_t is_move_Time_updated = 0; // by SEOL 연주중 time 이동시에 변경된 시각 표시해주기 위해
uint8_t repeat_status = 0;
uint8_t record_status = 0;

char printTime[] = "00:00"; // modified by SEOL
long total_Time; // by SEOL - 9.12
long original_total_Time; // by SEOL - 9.12
long prev_total_Time; // by SEOL -9.12
long prev_play_Time;
long delta_play_Time;
long play_Time; // by SEOL - 9.13  should be long (NOT unsigned long). play_Time can be - value temporally
long repeat_start_time;
long repeat_end_time;
long prev_repeat_start_time; // by SEOL - 9.13
long prev_repeat_end_time;


//char *printTime_for_play = "00:00"; // modified by SEOL
char printTime_for_play[6];
unsigned long start_Time;
long rest_Time = 0;
long move_Time = 0; // By SEOL - changed unsigned long to long - 9.12
long original_move_Time = 0; // by SEOL - 9.12
long skip_Time = 1000;
long last_moved_at = 0; // by SEOL - 9.13

uint8_t is_start = 0;
long pause_Time;
// long resume_Time; // no needed. you can directly use millis().

uint8_t is_resume = 0;

unsigned long previousMillis = 0;
unsigned long currentMillis = 0;

//////////////////////////////
File myFile;
File Root;

Sd2Card card;
//SdVolume volume;
SdFile root;
const int chipSelect = 77;

// for DUE Board
//#define ST_SHCP   22
//#define ST_STCP   23
//#define ST_DS   24
//#define FR_SDI   28
//#define FR_CLK   29
//#define FR_LE   30
//#define RED_LED_DIMM  32
//#define GREEN_LED_DIMM   33

// for All in One Board
#define ST_SHCP  42
#define ST_STCP  43
#define ST_DS  44
#define FR_SDI  45
#define FR_CLK  46
#define FR_LE  47
#define RED_LED_DIMM  53
#define GREEN_LED_DIMM  66



// 센싱 핀
// for DUE Board
//#define Sens_Data1 36
//#define Sens_Data2 37
//#define Sens_Data3 38
//#define Sens_Data4 39
//#define Latch_Sensing 42
//#define CK_Sensing 43

// for All in One Board
#define Sens_Data1 48
#define Sens_Data2 49
#define Sens_Data3 50
#define Sens_Data4 51
#define Latch_Sensing 60
#define CK_Sensing 59

#define INT0_Pin  6 //우크렐레????? 2==>6???
#define PWR_Latch  20
#define UNO_LED  11

#define RED 0
#define GREEN 1
#define YELLOW 2

unsigned long ST_Data = 0;
unsigned long ST_Raw = 0;
unsigned int FR_H_Data = 0;
unsigned int FR_L_Data = 0;

char ch = 0; //나중에 로컬 변수로 바꾸세요
uint8_t line = 1;
uint8_t fret = 1;
uint8_t location = 0;

uint8_t sensing_notes[30][2];
uint8_t sensing_notesCount = 0;
uint8_t notes[9][2]; // a set of notes to play
uint8_t notesCount = 0;

char axis[8];
uint8_t axis_len = 6;

double DURATION = 0;
double TEMPO = 0;
double original_DURATION = 0; // by SEOL. to keep original duration and tempo. tempo may change.
double original_TEMPO = 0;

uint8_t tempo_scale = 10; // 10 means x1.0 and 7 means x0.7

// by SEOL
unsigned long stime;
unsigned long current_time;
unsigned long elapsed_time;
//by SEOL
char rTitle[21];
char rArtist[20];
char rTime[7];
//char rNote[3200];
// 뽀뽀뽀 120!W1,3-@H1,3-@H2,1-4,2-@H1,3-@H2,1-4,2-@W2,1-1,2-3,2-@W1,3-@H1,3-@H2,1-4,2-@W2,1-1,2-3,2-@W1,3-@W1,3-@W2,1-4,2-@W1,3-@W2,1-1,2-3,2-@W1,3-@W2,1-4,2-@W1,3-@H2,1-1,2-3,2-@H1,3-@
// 산토끼(Rabbit) 120!W1,3-@W1,3-@W2,1-1,2-3,1-@W1,3-@W1,3-@W1,3-@W2,1-1,2-3,1-@W1,3-@
// 징글벨 Jingle 108!E3,2-@E1,2-@E1,0-@E2,3-@H3,2-@E3,2-@E1,2-@E1,0-@E2,3-@H2,0-@E2,0-@E1,3-@E1,2-@E1,0-@H2,2-@S1,5-@S1,0-@E1,5-@E1,3-@E1,0-@Q1,2-@Q2,3-@E3,2-@E1,2-@E1,0-@E2,3-@H3,2-@E3,2-@E1,2-@E1,0-@E2,3-@H2,0-@E2,0-@E1,3-@E1,2-@E1,0-@S1,5-@S1,0-@S1,5-@S1,0-@S1,5-@S1,0-@E1,5-@E1,7-@E1,5-@E1,3-@E1,0-@H2,3-@S1,2-@S1,0-@S1,2-@S1,0-@E1,2-@S1,2-@S1,0-@S1,2-@S1,0-@S1,2-@S1,0-@E1,2-@S1,2-@S1,0-@E1,2-@E1,5-@E2,3-@S2,3-@S1,0-@H1,2-@S1,3-@S1,0-@S1,3-@S1,0-@E1,3-@S1,0-@S1,3-@E1,3-@S1,2-@S1,0-@S1,2-@S1,0-@S1,2-@S1,0-@E1,2-@E1,0-@E1,0-@E2,3-@Q1,0-@Q1,5-@S1,2-@S1,0-@S1,2-@S1,0-@E1,2-@S1,2-@S1,0-@S1,2-@S1,0-@S1,2-@S1,0-@E1,2-@S1,2-@S1,0-@E1,2-@E1,5-@E2,3-@S2,3-@S1,0-@H1,2-@S1,2-@S1,0-@S1,2-@S1,0-@E1,3-@S1,0-@S1,3-@E1,3-@S1,2-@S1,0-@S1,2-@S1,0-@E1,2-@S1,5-@S1,0-@E1,5-@E1,3-@E1,0-@H2,3-@
char *rNote = "108!E3,2-@E1,2-@E1,0-@E2,3-@H3,2-@E3,2-@E1,2-@E1,0-@E2,3-@H2,0-@E2,0-@E1,3-@E1,2-@E1,0-@H2,2-@S1,5-@S1,0-@E1,5-@E1,3-@E1,0-@Q1,2-@Q2,3-@E3,2-@E1,2-@E1,0-@E2,3-@H3,2-@E3,2-@E1,2-@E1,0-@E2,3-@H2,0-@E2,0-@E1,3-@E1,2-@E1,0-@S1,5-@S1,0-@S1,5-@S1,0-@S1,5-@S1,0-@E1,5-@E1,7-@E1,5-@E1,3-@E1,0-@H2,3-@S1,2-@S1,0-@S1,2-@S1,0-@E1,2-@S1,2-@S1,0-@S1,2-@S1,0-@S1,2-@S1,0-@E1,2-@S1,2-@S1,0-@E1,2-@E1,5-@E2,3-@S2,3-@S1,0-@H1,2-@S1,3-@S1,0-@S1,3-@S1,0-@E1,3-@S1,0-@S1,3-@E1,3-@S1,2-@S1,0-@S1,2-@S1,0-@S1,2-@S1,0-@E1,2-@E1,0-@E1,0-@E2,3-@Q1,0-@Q1,5-@S1,2-@S1,0-@S1,2-@S1,0-@E1,2-@S1,2-@S1,0-@S1,2-@S1,0-@S1,2-@S1,0-@E1,2-@S1,2-@S1,0-@E1,2-@E1,5-@E2,3-@S2,3-@S1,0-@H1,2-@S1,2-@S1,0-@S1,2-@S1,0-@E1,3-@S1,0-@S1,3-@E1,3-@S1,2-@S1,0-@S1,2-@S1,0-@E1,2-@S1,5-@S1,0-@E1,5-@E1,3-@E1,0-@H2,3-@";
//char *rNote = "108!E0,0-@E0,0-@E0,0-@E0,0-@H0,0-@H0,0-@H0,0-@H0,0-@H0,0-@H0,0-@H0,0-@H0,0-@H0,0-@H0,0-@H0,0-@H0,0-@H0,0-@H0,0-@H0,0-@H0,0-@H0,0-@H0,0-@H0,0-@H0,0-@H0,0-@H0,0-@H0,0-@H0,0-@H0,0-@H0,0-@H0,0-@H0,0-@H0,0-@H0,0-@H0,0-@H0,0-@H0,0-@H0,0-@H0,0-@H0,0-@H0,0-@H0,0-@H0,0-@H0,0-@H0,0-@H0,0-@H0,0-@H0,0-@H0,0-@H0,0-@H0,0-@H0,0-@H0,0-@H0,0-@H0,0-@H0,0-@H0,0-@H0,0-@H0,0-@H0,0-@H0,0-@H0,0-@H0,0-@H0,0-@H0,0-@H0,0-@H0,0-@H0,0-@H0,0-@H0,0-@H0,0-@H0,0-@H0,0-@H0,0-@H0,0-@H0,0-@H0,0-@H0,0-@H0,0-@H0,0-@H0,0-@H0,0-@H0,0-@H0,0-@H0,0-@H0,0-@H0,0-@H0,0-@H0,0-@H0,0-@H0,0-@H0,0-@H0,0-@H0,0-@H0,0-@H0,0-@H0,0-@H0,0-@H0,0-@H0,0-@H0,0-@H0,0-@";

int noteIndex = 0;
double timeCount = 0;
double sTime = 0; //시작시간
double eTime = 0; //끝난시간

unsigned long pinVal = 0;

boolean start = false;

unsigned long prev_time = 0;

boolean stringFlag1 = false;
boolean stringFlag2 = false;
boolean stringFlag3 = false;
boolean stringFlag4 = false;
boolean stringFlag5 = false;
boolean stringFlag6 = false;

int sample_count = 0;

int max1 = 0;
int max2 = 0;
int max3 = 0;
int max4 = 0;
int max5 = 0;
int max6 = 0;

int count1 = 0;
int count2 = 0;
int count3 = 0;
int count4 = 0;
int count5 = 0;
int count6 = 0;

int scan1 = 0;
int scan2 = 0;
int scan3 = 0;
int scan4 = 0;
int scan5 = 0;
int scan6 = 0;

int avg_scan1 = 0;
int avg_scan2 = 0;
int avg_scan3 = 0;
int avg_scan4 = 0;
int avg_scan5 = 0;
int avg_scan6 = 0;

int play_count1 = 0;
int play_count2 = 0;
int play_count3 = 0;
int play_count4 = 0;
int play_count5 = 0;
int play_count6 = 0;

//typedef struct {
//  char noteFret [3];
//  char noteString [2];
//  char startTime [7];
//  char endTime [7];
//
//} NoteSensing;

#define record_max 600

typedef struct {
  int noteFret;
  int noteString;
  double startTime;
  double endTime;
} NoteSensing;

NoteSensing record_note [record_max];

boolean onPaused = false;
boolean realtime_play_stop = false;

static const unsigned char PROGMEM backbmp[] = {

  B00000000, B00000000, B00000000,
  B00000000, B00000000, B00000000,
  B00000100, B00000000, B00000000,
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  B00000000, B00000000, B00000000// 20*18 by umin

};

static const unsigned char PROGMEM bluetoothbmp[] = {

  B00001111, B00000000, // 00001111 0000
  B00111001, B11000000, // 00111001 1100
  B01111010, B11100000, // 01111010 1110
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  B00001111, B00000000, // 00001111 0000
  // 12*12 by umin

};

const unsigned char PROGMEM play_list_bmp [] = {
  0x00, 0x00, 0x00, 0x00, 0x00, 0x00, 0x00, 0x00, 0x00, 0x00, 0x00, 0x00, 0x00, 0x00, 0x00, 0x00,
  0x00, 0x1C, 0x00, 0x00, 0x00, 0x00, 0x1F, 0xC0, 0x00, 0x00, 0x00, 0x10, 0xE0, 0x00, 0x00, 0x30,
  0x1F, 0x20, 0x00, 0x00, 0x78, 0x13, 0xE0, 0x00, 0x00, 0x58, 0x10, 0x22, 0x00, 0x00, 0xC8, 0x10,
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  0x00, 0x00, 0x00, 0x00, 0x00, 0x00, 0x00, 0x00,
};

const unsigned char PROGMEM guitar_chord_bmp [] = {
  0x00, 0x00, 0x00, 0x00, 0x00, 0x3F, 0xFF, 0xFF, 0xFF, 0xF8, 0x7F, 0xFF, 0xFF, 0x1E, 0x3C, 0x7F,
  0xFF, 0xFE, 0x0C, 0x1C, 0x7F, 0xFF, 0xFE, 0x0C, 0x1C, 0x7F, 0xFF, 0xFE, 0x0C, 0x1C, 0x7F, 0xFF,
  0xFF, 0x1E, 0x3C, 0x7F, 0xFF, 0xFF, 0xFF, 0xFC, 0x7F, 0xFF, 0xFF, 0xFF, 0xFC, 0x78, 0xFC, 0x7E,
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  0xFF, 0xFF, 0xF0, 0x00, 0x00, 0x00, 0x00, 0x00,
};

const unsigned char PROGMEM live_play_bmp [] = {
  0x00, 0x00, 0x00, 0x00, 0x00, 0x00, 0xE0, 0x00, 0x00, 0x00, 0x03, 0xC0, 0x00, 0x00, 0x00, 0x07,
  0x80, 0x00, 0x00, 0x00, 0x0E, 0x38, 0x00, 0x00, 0x00, 0x1C, 0x70, 0x0F, 0xFF, 0xF0, 0x18, 0xE1,
  0x9F, 0xFF, 0xF8, 0x39, 0x87, 0x3F, 0xFF, 0xF8, 0x31, 0x8E, 0x3F, 0xC3, 0xFC, 0x31, 0x98, 0x3F,
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  0x0F, 0xFF, 0xF0, 0x00, 0x00, 0x00, 0x00, 0x00,
};

const unsigned char PROGMEM record_bmp [] = {
  0x00, 0x00, 0x00, 0x00, 0x00, 0x00, 0x01, 0xFF, 0x80, 0x00, 0x00, 0x07, 0xFF, 0xE0, 0x00, 0x00,
  0x3F, 0xFF, 0xFC, 0x00, 0x00, 0xFF, 0xFF, 0xFF, 0x00, 0x01, 0xFF, 0xFF, 0xFF, 0x80, 0x03, 0xFF,
  0xFF, 0xFF, 0x80, 0x03, 0xFF, 0xFF, 0xFF, 0xC0, 0x0F, 0xFF, 0xFF, 0xFF, 0xF0, 0x0F, 0xFF, 0xFF,
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  0x00, 0x00, 0x00, 0x00, 0x00, 0x00, 0x00, 0x00,
};

const unsigned char PROGMEM file_manager_bmp [] = {
  0x0F, 0xFF, 0xF0, 0x00, 0x00, 0x3F, 0xFF, 0xFC, 0x00, 0x00, 0x7F, 0xFF, 0xFE, 0x00, 0x00, 0x78,
  0x00, 0x1F, 0x00, 0x00, 0xF0, 0x00, 0x1F, 0x80, 0x00, 0xE0, 0x00, 0x1F, 0xC0, 0x00, 0xE0, 0x00,
  0x1F, 0xE0, 0x00, 0xE0, 0x00, 0x1F, 0xF0, 0x00, 0xE0, 0x00, 0x1F, 0xF8, 0x00, 0xE0, 0x00, 0x1F,
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  0xFE, 0x1C, 0x00, 0x0F, 0xFF, 0xFF, 0x00, 0x00,
};

const unsigned char PROGMEM format_bmp [] = {
  0x00, 0x00, 0xFF, 0x00, 0x00, 0x00, 0x03, 0xFF, 0xC0, 0x00, 0x00, 0x07, 0xFF, 0xE0, 0x00, 0x00,
  0x07, 0x00, 0xE0, 0x00, 0x00, 0x07, 0x00, 0xE0, 0x00, 0x00, 0x0E, 0x00, 0x70, 0x00, 0x03, 0xFF,
  0xFF, 0xFF, 0xC0, 0x07, 0xFF, 0xFF, 0xFF, 0xE0, 0x07, 0xFF, 0xFF, 0xFF, 0xE0, 0x1F, 0xFF, 0xFF,
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  0xFF, 0xFF, 0x00, 0x00, 0x7F, 0xFF, 0xFE, 0x00,
};

const unsigned char PROGMEM setting_bmp [] = {
  0x00, 0x00, 0x00, 0x00, 0xC0, 0x00, 0x00, 0x00, 0x00, 0xC0, 0x00, 0x00, 0x00, 0x08, 0xC4, 0x00,
  0x00, 0x00, 0x1F, 0xFE, 0x00, 0x00, 0x00, 0x0F, 0xFC, 0x00, 0x00, 0x00, 0x0E, 0x1C, 0x00, 0x00,
  0x00, 0x1C, 0x0C, 0x00, 0x00, 0x00, 0x7C, 0x0F, 0x00, 0x00, 0x00, 0x7C, 0x0F, 0x00, 0x00, 0x00,
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  0xC0, 0x00, 0x00, 0x00, 0x07, 0xC0, 0x00, 0x00,
};


#define OLED_RESET 4
Adafruit_SSD1306 display(OLED_RESET);
#if (SSD1306_LCDHEIGHT != 64)
#error("Height incorrect, please fix Adafruit_SSD1306.h!");
#endif


void setup() {

  ADC->ADC_MR |= 0x80;  //set free running mode on ADC , Mode Register
  ADC->ADC_CR = 2; // set conversion mode on ADC, Control Register
  ADC->ADC_CHDR = 0x3CFF; // disable all channels , Channel Disable Register
  ADC->ADC_CHER = 0x3C30;     // use channels 5, 4, 10~13 , Channel Enable Register

  SerialUSB.begin(9600);
  Serial3.begin(9600);
  uiSetup();
  OLEDSetup();
  LEDBoardSetup();
  delay(1000);
  //  LEDBoardtest();
  Timer3.attachInterrupt(getFret);
  Timer4.attachInterrupt(sense_Note);

  if (!SD.begin(chipSelect, SPI_HALF_SPEED)) SerialUSB.println("SDcard initialization failed.");

  for (int i = 0; i < 600; i++) {
    record_note[i].noteFret = 99;
    record_note[i].noteString = 99;
  }

}

void loop() {

  uiStep();
  updateMenu();
  checkPowerOff();

  if ( menu_redraw_required != 0 ) {

    switch (mymenu) {

      case MAIN_MENU: drawMainMenu(); break;
      case PLAYLIST_MENU:
        drawListMenu();
        total_Time = atol(rTime);
        original_total_Time = total_Time;
        break;
      case PLAY_MENU:
        struct_Turn_on_LED(menu_current - 1);
        if (mymenu == PLAYLIST_MENU) drawListMenu();
        break;
      case CHORD_MENU: drawChordMenu(); break;
      case SUBCHORD_MENU: drawChordMenu(); break;
      case RECORD_MENU: drawRecordMenu(); break;
      case SETTING_MENU: drawSettingMenu(); break;
      default: drawSubMenu(); break;

    }

    menu_redraw_required = 0;

  }

}

////////////////////////////// LED BOARD LOGO
void displayLogo() {

  for (int y = 1; y <= 21; y++) {
    for (int repeat = 0; repeat < 2; repeat++) {
      for (int x = 1; x <= 6; x++) {
        setNote(x, y);
        play(GREEN);
        LED_turnoff();
        setNote(x, y - 1);
        play(YELLOW);
        LED_turnoff();
        setNote(x, y - 2);
        play(RED);
        LED_turnoff();
      }
    }
  }
  for (int y = 21; y >= 1; y--) {
    for (int repeat = 0; repeat < 4; repeat++) {
      for (int x = 1; x <= 6; x++) {
        setNote(x, y);
        play(GREEN);
        LED_turnoff();
        setNote(x, y + 1);
        play(YELLOW);
        LED_turnoff();
        setNote(x, y + 2);
        play(RED);
        LED_turnoff();
      }
    }
  }

}

void test_LED_scattering() {

  for (int y = 2; y <= 3; y++) {
    for (int repeat = 0; repeat < 1; repeat++) {
      for (int x = 1; x <= 6; x++) {
        setNote(x, y);
        play(YELLOW);
        delay(2000);
        LED_turnoff();
      }
    }
  }

  for (int y = 21; y >= 6; y--) {
    for (int repeat = 0; repeat < 1; repeat++) {
      for (int x = 1; x <= 6; x++) {
        setNote(x, y);
        play(YELLOW);
        delay(2000);
        LED_turnoff();
      }
    }
  }

}
